## applications/press/src/events/Kconfig
```kconfig
#
# Copyright (c) 2020 Nordic Semiconductor
#
# SPDX-License-Identifier: LicenseRef-BSD-5-Clause-Nordic
#

if LOG

menu "Event options"

comment "Initially logged events"

config PRESS_LOG_MODULE_STATE_EVENT
	bool "Module state event"
	default y

config PRESS_LOG_POTMETER_CTRL_EVENT
	bool "Potmeter control event"
	default y

config PRESS_LOG_POTMETER_DATA_EVENT
	bool "Potmeter data event"
	default y

config PRESS_LOG_HX711_CTRL_EVENT
	bool "HX711 ctrl event"
	default y

config PRESS_LOG_HX711_STATE_EVENT
	bool "HX711 state event"
	default y

config PRESS_LOG_HX711_DATA_EVENT
	bool "HX711 data event"
	default y

config PRESS_LOG_TB6612FNG_CTRL_EVENT
	bool "TB6612FNG ctrl event"
	default y

endmenu

endif
```

## applications/press/src/modules/Kconfig
```kconfig
menu "Controller"

comment "Controller configuration"

module = PRESS_CONTROLLER
module-str = Controller
source "subsys/logging/Kconfig.template.log_config"

config CONTROLLER_CYCLE
	int "Controller cycle [ms]"
	range 100 10000
	default 2500

config CONTROLLER_HYSTERESIS
	int "Hysteresis range [g]"
	range 10 1000
	default 100

endmenu

menu "HX711 sensor"

comment "HX711 sensor configuration"

module = PRESS_HX711_SENSOR
module-str = Weight sensor
source "subsys/logging/Kconfig.template.log_config"

config PRESS_HX711_SENSOR_SPI_DEV
	string "HX711 sensor SPI device"
	default "SPI_0"

config PRESS_HX711_SENSOR_CHN_A_ENABLE
	bool "HX711 channel A enable"
	default y

config PRESS_HX711_SENSOR_CHN_B_ENABLE
	bool "HX711 channel B enable"
	default y

if PRESS_HX711_SENSOR_CHN_A_ENABLE

choice
	prompt "Channel A gain"
	default PRESS_HX711_SENSOR_CHN_A_GAIN_64

config PRESS_HX711_SENSOR_CHN_A_GAIN_64
	bool "64 gain"

config PRESS_HX711_SENSOR_CHN_A_GAIN_128
	bool "128 gain"

endchoice

config PRESS_HX711_TARE_DURATION
	int "HX711 tare weight stabilization duration [s]"
	default 10

config PRESS_HX711_AVG_LENGTH
	int "HX711 averaging filter length"
	default 16

endif # PRESS_HX711_SENSOR_CHN_A_ENABLE

endmenu

menu "Potmeter"

comment "Potmeter configuration"

module = PRESS_POTMETER
module-str = Potmeter
source "subsys/logging/Kconfig.template.log_config"

config POTMETER_VDD_VOLTAGE
	int "Potmeter VDD voltage [mV]"
	default 3000

config POTMETER_STEP_COUNT
	int "Potmeter step count"
	default 500

config POTMETER_SAMPLE_RATE
	int "Potmeter sample rate [Hz]"
    range 1 1000
	default 100

endmenu

menu "Motor controller"

comment "Motor controller configuration"

module = PRESS_TB6612FNG
module-str = Motor controller
source "subsys/logging/Kconfig.template.log_config"

config TB6612FNG_PWM_RATE
	int "TB6612FNG PWM rate [Hz]"
    range 1000 100000
	default 50000

endmenu

menu "Display"

comment "Display configuration"

module = PRESS_DISPLAY
module-str = Display
source "subsys/logging/Kconfig.template.log_config"

config DISPLAY_REFRESH_RATE
	int "Display refresh rate [Hz]"
    range 1 30
	default 10

endmenu
```

## drivers/flash/Kconfig
```kconfig
menuconfig FLASH
	bool "Flash hardware support"
	help
	  Enable support for the flash hardware.

if FLASH

rsource "Kconfig.at45d"

endif # FLASH
```

## drivers/flash/Kconfig.at45d
```kconfig
# Copyright (c) 2020 Nordic Semiconductor ASA
# SPDX-License-Identifier: Apache-2.0

menuconfig SPI_FLASH_AT45D
	bool "AT45D family DataFlash driver"
	select FLASH_HAS_DRIVER_ENABLED
	depends on SPI

if SPI_FLASH_AT45D

config SPI_FLASH_AT45D_INIT_PRIORITY
	int "Driver initialization priority"
	default 80
	help
	  Device driver initialization priority.
	  SPI driver needs to be initialized before this one.

endif # SPI_FLASH_AT45D
```

## drivers/pmic/Kconfig
```kconfig
# Nordic PMIC driver for nPM6001
#
# Copyright (c) 2022 Nordic Semiconductor
#
# SPDX-License-Identifier: LicenseRef-Nordic-5-Clause
#

config PMIC_NPM6001
	bool "nRF700x driver"
	depends on LIB_NPM6001
    depends on I2C
	help
	  Nordic nPM6001 PMIC driver

if PMIC_NPM6001

config PMIC_NPM6001_INIT_PRIORITY
	int "nPM6001 init priority"
	default 90
	help
	  nPM6001 initialization priority.

endif # PMIC_NPM6001
```

## dts/bindings/mtd/adesto,at45d.yaml
```yaml
# Copyright (c) 2020 Nordic Semiconductor ASA
# SPDX-License-Identifier: Apache-2.0

description: Adesto AT45D family DataFlash SPI Memory

compatible: "adesto,at45d"

include: [spi-device.yaml]

properties:
  jedec-id:
    type: uint8-array
    required: true
    description: JEDEC ID as manufacturer ID, memory type, memory density

  size:
    type: int
    required: true
    description: flash capacity in bits

  block-size:
    type: int
    required: true
    description: flash block size in bytes

  page-size:
    type: int
    required: true
    description: flash page size in bytes

  wp-gpios:
    type: phandle-array
    required: false
    description: WPn pin

  reset-gpios:
    type: phandle-array
    required: false
    description: RESETn pin
```

## dts/bindings/pmic/nordic,npm6001.yaml
```yaml
# Copyright (c) 2022 Nordic Semiconductor ASA
# SPDX-License-Identifier: LicenseRef-Nordic-5-Clause

description: nPM6001 power management IC

compatible: "nordic,npm6001"

include: i2c-device.yaml

properties:
    irq-gpios:
      type: phandle-array
      required: false
      description: N_INT interrupt pin
    buck0-voltage:
        type: int
        required: true
        description: |
          BUCK0 regulator default voltage in millivolts.
          Valid range: 1800 mV - 3300 mV
    buck1-voltage:
        type: int
        required: false
        default: 0
        description: |
          BUCK1 regulator default voltage in millivolts.
          Valid range: 700 mV - 1400 mV
    buck2-voltage:
        type: int
        required: false
        default: 0
        description: |
          BUCK2 regulator default voltage in millivolts.
          Valid range: 1200 mV - 1400 mV
    buck3-voltage:
        type: int
        required: false
        default: 0
        description: |
          BUCK3 regulator default voltage in millivolts.
          Valid range: 500 mV - 3300 mV
    ldo0-voltage:
        type: int
        required: false
        default: 0
        description: |
          LDO0 regulator default voltage in millivolts.
          Valid range: 1800 mV - 3300 mV
    ldo1-voltage:
        type: int
        required: false
        default: 0
        description: |
          LDO1 regulator default voltage in millivolts.
          Valid range: 1800 mV
```

## samples/nrf9160/http_modem_update/mfu/Kconfig
```kconfig
#
# Copyright (c) 2019 Nordic Semiconductor ASA
#
# SPDX-License-Identifier: LicenseRef-BSD-5-Clause-Nordic
#

config MFU_ENABLE
	bool "Enable Modem Firmware Updater"
	select FLASH
	select DFU_TARGET_MODEM
	help
		The modem firmware updater is responsible for validating a modem update
		package and applying the update to the modem.

if MFU_ENABLE

module=MFU
module-dep=LOG
module-str=Device Firmware Upgrade
source "${ZEPHYR_BASE}/subsys/logging/Kconfig.template.log_config"

config MFU_FLASH_BUF_SIZE
	int "Flash buffer size"
	default 512
	range 64 4096
	help
		Size of static buffer used for flash reading.

choice
	prompt "SHA256 backend"
	default MFU_SHA256_BACKEND_MBEDTLS

config MFU_SHA256_BACKEND_MBEDTLS
	bool "Mbedtls"
	select NORDIC_SECURITY_BACKEND
	help
	  Use SHA256 implementation from mbedtls.

config MFU_SHA256_BACKEND_TINYCRYPT
	bool "Tinycrypt"
	select TINYCRYPT
	select TINYCRYPT_SHA256
	help
	  Use SHA256 implementation from Tinycrypt.

endchoice

config MFU_STREAM_VERIFICATION_ENABLE
	bool "Enable verification of update stream"
	default y
	help
		Stream verification exposes functions to run verification on an
		update file as it is downloaded.
		This increases static RAM usage by ~150 bytes.

endif # MFU_ENABLE
```

## samples/nrf9160/skyhook_client/embedded_client/Kconfig
```kconfig
#
# Copyright (c) 2020 Nordic Semiconductor ASA
#
# SPDX-License-Identifier: LicenseRef-Nordic-5-Clause
#

config SKYHOOK_EMBEDDED_CLIENT
	bool "Enable Skyhook embedded client library"

config APP_LINK_WITH_SKYHOOK_EMBEDDED_CLIENT
	bool "Link 'app' with Skyhook embedded client Proto headers"
	default y
	help
	  Add Skyhook embedded client files to the 'app' include path.
```
