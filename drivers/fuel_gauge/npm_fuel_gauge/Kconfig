## drivers/fuel_gauge/npm_fuel_gauge/Kconfig
```kconfig
#
# Copyright (c) 2026 Nordic Semiconductor ASA
#
# SPDX-License-Identifier: LicenseRef-Nordic-5-Clause
#

config NPM_FUEL_GAUGE
	bool "nPM fuel gauge"
	default y
	depends on (DT_HAS_NORDIC_NPM_FUEL_GAUGE_PRIMARY_ENABLED || DT_HAS_NORDIC_NPM_FUEL_GAUGE_SECONDARY_ENABLED)
	select NRF_FUEL_GAUGE
	help
	  Enable driver for the Nordic npm fuel gauge device.

if DT_HAS_NORDIC_NPM_FUEL_GAUGE_PRIMARY_ENABLED

choice NRF_FUEL_GAUGE_VARIANT
	default NRF_FUEL_GAUGE_VARIANT_PRIMARY_CELL
endchoice

endif # DT_HAS_NORDIC_NPM_FUEL_GAUGE_PRIMARY_ENABLED

if DT_HAS_NORDIC_NPM_FUEL_GAUGE_SECONDARY_ENABLED

choice NRF_FUEL_GAUGE_VARIANT
	default NRF_FUEL_GAUGE_VARIANT_SECONDARY_CELL
endchoice

endif # DT_HAS_NORDIC_NPM_FUEL_GAUGE_SECONDARY_ENABLED

if NPM_FUEL_GAUGE

config NPM_FUEL_GAUGE_THREAD_PRIORITY
	int "Thread priority"
	default 10
	help
	  Priority of thread used to read measurements and process the fuel gauge algorithm.

config NPM_FUEL_GAUGE_THREAD_STACK_SIZE
	int "Thread stack size"
	default 2048
	help
	  Stack size of thread used to read measurements and process the fuel gauge algorithm.

endif # NPM_FUEL_GAUGE
```

## dts/bindings/fuel-gauge/nordic,npm-fuel-gauge-primary.yaml
```yaml
description: |
  nPM Fuel Gauge library virtual device for primary cell batteries

compatible: "nordic,npm-fuel-gauge-primary"

include: "nordic,npm-fuel-gauge.yaml"
```

## dts/bindings/fuel-gauge/nordic,npm-fuel-gauge-secondary.yaml
```yaml
description: |
  nPM Fuel Gauge library virtual device for secondary cell batteries

compatible: "nordic,npm-fuel-gauge-secondary"

include: "nordic,npm-fuel-gauge.yaml"

properties:
  charger-device:
    type: phandle
    required: true
    description: |
      nPM PMIC charger device.

      Device must implement the charger API.

  runtime-charger-updates:
    type: boolean
    description: |
      Indicates whether runtime adjustment to charger properties updates will happen.
      If they are, the fuel gauge library will fetch charger configuration at runtime.
```

## dts/bindings/fuel-gauge/nordic,npm-fuel-gauge.yaml
```yaml
description: |
  nPM Fuel Gauge library virtual device common properties

include: [fuel-gauge.yaml]

properties:
  sensor-device:
    type: phandle
    required: true
    description: |
      nPM PMIC sensor device.

      Device must implement the sensor API.

  processing-interval:
    type: int
    default: 1000
    description: |
      Default processing interval in milliseconds.
      This is the interval at which the fuel gauge library will process the sensor data
      and update the fuel gauge state.

  battery-model:
    type: string
    required: false
    description: |
      Name of the battery model to use for the fuel gauge.
      The battery model must be registered in the iterable section
      "battery_model" or "battery_model_primary" in ROM.
      If not set, battery model must be set at runtime using driver API.

  idle-current-ua:
    type: int
    default: 5
    description: |
      Default idle current in microamperes.
      This value will be used as the default system idle current for the fuel gauge library when the
      low power state is set.

  temperature-measurement:
    type: string
    default: "ntc"
    enum:
      - "ntc"
      - "die"
      - "static"
    description: |
      Temperature measurement method to use for the fuel gauge.
      Options are:
        - ntc: Use an NTC thermistor for temperature measurement.
        - die: Use the die temperature of the PMIC.
        - static: Use a static temperature value specified by static-temperature.

  static-temperature:
    type: int
    default: 25
    description: |
      Static temperature value in Celsius to use when temperature-measurement is set to static.
```
